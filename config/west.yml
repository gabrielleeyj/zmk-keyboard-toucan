## config/west.yml
```yaml
manifest:
  defaults:
    revision: v0.3
  remotes:
    - name: zmkfirmware
      url-base: https://github.com/zmkfirmware
    - name: petejohanson
      url-base: https://github.com/petejohanson/
    - name: caksoylar
      url-base: https://github.com/caksoylar
  projects:
    - name: zmk
      remote: zmkfirmware
      revision: 3cf9006a9377f21c99e944e29e2a507d8c3e9069 # v0.3
      import: app/west.yml
    - name: zephyr
      remote: zmkfirmware
      revision: dacab4875df72109b96cc8977547a0dc04875bcd # v3.5.0+zmk-fixes
      import:
        name-blocklist:
          - ci-tools
          - hal_altera
          - hal_cypress
          - hal_infineon
          - hal_microchip
          - hal_nxp
          - hal_openisa
          - hal_silabs
          - hal_xtensa
          - hal_st
          - hal_ti
          - loramac-node
          - mcuboot
          - mcumgr
          - net-tools
          - openthread
          - edtt
          - trusted-firmware-m
      # RGB LED widget
    - name: zmk-rgbled-widget
      remote: caksoylar
      revision: v0.3
    # Cirque trackpad input module. petejohanson/main is the driver the touchpad
    # is confirmed working with (matches f4269af), running the pad in relative
    # mode (no abs-rel-divisor in the overlay). The geeksville/kalbasit forks
    # required absolute mode and left the pad dead on this build.
    - name: cirque-input-module
      remote: petejohanson
      revision: main
  self:
    path: config
```
